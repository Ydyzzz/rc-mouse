## CMakeLists.txt
```
cmake_minimum_required(VERSION 3.20.0)
find_package(Zephyr REQUIRED HINTS $ENV{ZEPHYR_BASE})
project(rc-mouse)

set(CMAKE_EXPORT_COMPILE_COMMANDS 1)

set(NEC_SRC src/nec-decoder.c)
set(IR_INPUT_SRC src/ir-input.c)
set(MOUSE_HID_SRC src/mouse-hid.c)
set(APP_SRC src/main.c)
set(RC_MOUSE_SRC src/rc-mouse.c)

target_sources(app PRIVATE ${APP_SRC} ${NEC_SRC} ${IR_INPUT_SRC} ${MOUSE_HID_SRC} ${RC_MOUSE_SRC})
```

## prj.conf
```kconfig
CONFIG_USB_DEVICE_STACK=y
CONFIG_USB_DEVICE_HID=y
CONFIG_USB_DEVICE_PRODUCT="rc-mouse"
CONFIG_USB_DEVICE_PID=0x0007
CONFIG_USB_DEVICE_VID=0xdead
CONFIG_USB_DEVICE_INITIALIZE_AT_BOOT=n

CONFIG_LOG=y
CONFIG_USB_DRIVER_LOG_LEVEL_ERR=y
CONFIG_USB_DEVICE_LOG_LEVEL_ERR=y
CONFIG_LOG_PROCESS_THREAD=y

CONFIG_GPIO=y

CONFIG_THREAD_MONITOR=y
```

## app.overlay
```dts
/ {
    inputs {
        compatible = "gpio-keys";
        ir_input: ir_input {
            label = "IR input";
            gpios = <&gpiob 12 (GPIO_ACTIVE_HIGH | GPIO_PULL_UP)>;
        };
    };
};
```

## src/main.c
```c
#include "nec-decoder.h"
#include "ir-input.h"
#include "mouse-hid.h"
#include "rc-mouse.h"
#include "rc-command.h"

#include <zephyr/kernel.h>
#include <zephyr/device.h>
#include <zephyr/drivers/gpio.h>
#include <zephyr/input/input.h>
#include <zephyr/sys/util.h>
#include <zephyr/sys/slist.h>
#include <zephyr/sys/time_units.h>
#include <zephyr/usb/usb_device.h>
#include <zephyr/usb/usbd.h>
#include <zephyr/usb/class/usb_hid.h>
#include <zephyr/logging/log.h>

#include <string.h>


LOG_MODULE_REGISTER(main, LOG_LEVEL_INF);

K_MSGQ_DEFINE(rc_mouse_msg_queue, sizeof(rc_mouse_input_t), 20, 1);
static const struct gpio_dt_spec ir_input = GPIO_DT_SPEC_GET(DT_NODELABEL(ir_input), gpios);
static struct gpio_callback ir_input_callback_data;
static ir_input_handler_t ir_input_handler;

void ir_input_callback(const struct device *dev, struct gpio_callback *cb, uint32_t pins) {
   uint64_t cyc = k_cycle_get_32();
   int v = gpio_pin_get_dt(&ir_input);
   ir_input_handler.on_incoming(&ir_input_handler, v, cyc);
}


int ir_input_init() {
  int ret;

  if (!gpio_is_ready_dt(&ir_input)) {
    LOG_ERR("IR input device '%s' is not ready", ir_input.port->name);
    return -1;
  }

  ret = gpio_pin_configure_dt(&ir_input, GPIO_INPUT);
  if (ret != 0) {
    LOG_ERR("error %d: failed to configure '%s' pin %d", ret, ir_input.port->name, ir_input.pin);
    return -1;
  }

  ret = gpio_pin_interrupt_configure_dt(&ir_input, GPIO_INT_EDGE_BOTH);
  if (ret != 0) {
    LOG_ERR("error %d: failed to configure interrupt on '%s' pin %d", ret, ir_input.port->name, ir_input.pin);
    return -1;
  }

  gpio_init_callback(&ir_input_callback_data, ir_input_callback, BIT(ir_input.pin));
  gpio_add_callback_dt(&ir_input, &ir_input_callback_data);

  return 0;
}


// ISR context
void on_command(uint8_t address, uint8_t command) {
  ARG_UNUSED(address);
  rc_mouse_input_t input = {0};
  switch (command) {
  case RC_COMMAND_RIGHT:
    input.type = RC_MOUSE_MOVE_RIGHT;
    break;
  case RC_COMMAND_LEFT:
    input.type = RC_MOUSE_MOVE_LEFT;
    break;
  case RC_COMMAND_UP:
    input.type = RC_MOUSE_MOVE_UP;
    break;
  case RC_COMMAND_DOWN:
    input.type = RC_MOUSE_MOVE_DOWN;
    break;
  case RC_COMMAND_LEFT_CLICK:
    input.type = RC_MOUSE_CLICK_LEFT;
    break;
  default:
    LOG_WRN("unknown command='%d'", command);
  }

  if (k_msgq_put(&rc_mouse_msg_queue, &input, K_NO_WAIT) != 0) {
    LOG_ERR("can not put rc input");
  }
}

// ISR context
void on_repeat() {
  rc_mouse_input_t input = {0};
  input.type = RC_MOUSE_REPEAT;
  if (k_msgq_put(&rc_mouse_msg_queue, &input, K_NO_WAIT) != 0) {
    LOG_ERR("can not put rc input");
  }
}

int main(void) {
  LOG_INF("rc-mouse");

  ir_input_handler_init(&ir_input_handler);
  ir_input_handler.on_command = on_command;
  ir_input_handler.on_repeat = on_repeat;


  if (ir_input_init() != 0) {
    return -1;
  }

  if (mouse_hid_init("HID_0") != 0) {
    return -1;
  }

  rc_mouse_start_thread(&rc_mouse_msg_queue);
  LOG_INF("rc-mouse thread started");


  // to allow log thread out logs
  k_thread_priority_set(k_current_get(), 15);

  while (true) {
    k_yield();
  }
	return 0;
}
```

## src/ir-input.c
```c
#include "ir-input.h"
#include "nec-decoder.h"

#include <stdint.h>
#include <zephyr/sys_clock.h>
#include <zephyr/logging/log.h>

#include <stdio.h>

LOG_MODULE_REGISTER(ir_input, LOG_LEVEL_INF);

// FWD
static void _ir_input_on_data_received(ir_input_handler_t *this, uint32_t val, uint32_t tick);

static void _ir_input_on_data_reset(ir_input_handler_t *this, uint32_t val, uint32_t tick) {
  this->val = val;
  this->tick = tick;
  this->on_incoming = _ir_input_on_data_received;
}

static void _ir_input_on_data_received(ir_input_handler_t *this, uint32_t val, uint32_t tick) {
  uint32_t dt = 0;
  // TODO need to check this
  if (tick > this->tick) {
    dt = k_cyc_to_us_ceil32(tick) - k_cyc_to_us_ceil32(this->tick);
  } else {
    dt = k_cyc_to_us_ceil32(UINT32_MAX - tick) + k_cyc_to_us_ceil32(this->tick);
  }
  nec_decoder_signal_t signal = {
    .form = this->val == 1? NEC_DECODER_SIGNAL_FORM_PULSE: NEC_DECODER_SIGNAL_FORM_SPACE,
    .duration = dt,
  };

  nec_decoder_result_e nec_result = nec_decoder_feed(&this->nec_decoder, &this->nec_decoder_message, &signal);
  if (nec_result == NEC_DECODER_FAILED) {
    if (val == 1) {
      ir_input_handler_init(this);
      return;
    }
  }
  if (nec_result == NEC_DECODER_MESSAGE_DECODED) {
    this->on_command(this->nec_decoder_message.address, this->nec_decoder_message.command);
    //LOG_INF("decoded: address=%d, command=%d\n", this->nec_decoder_message.address, this->nec_decoder_message.command);
    // set timer
  }
  if (nec_result == NEC_DECODER_REPEAT_DECODED) {
    //LOG_INF("decoded: repeat");
    this->on_repeat();
  }

  this->val = val;
  this->tick = tick;
}

void ir_input_handler_init(ir_input_handler_t *this) {
  this->on_incoming = _ir_input_on_data_reset;
  this->tick = 0;
  this->val = 0;
  nec_decoder_init(&this->nec_decoder);
}
```

## src/ir-input.h
```c
#pragma once

#include "nec-decoder.h"

#include <stdint.h>

struct ir_input_handler;
typedef void (*ir_input_handler_f)(struct ir_input_handler*, uint32_t, uint32_t);
typedef void (*on_command_f)(uint8_t, uint8_t);
typedef void (*on_repeat_f)();

typedef struct ir_input_handler {
  ir_input_handler_f on_incoming;
  on_command_f on_command;
  on_repeat_f on_repeat;
  nec_decoder_t nec_decoder;
  nec_decoder_message_t nec_decoder_message;

  uint32_t val;
  uint32_t tick;
} ir_input_handler_t;

void ir_input_handler_init(ir_input_handler_t *handler);
```

## src/mouse-hid.c
```c
#include "mouse-hid.h"

#include <zephyr/logging/log.h>
#include <zephyr/usb/class/usb_hid.h>
#include <zephyr/usb/usb_device.h>
#include <zephyr/usb/usbd.h>

#define MOUSE_BTN_LEFT		0
#define MOUSE_BTN_RIGHT		1

typedef enum mouse_hid_report_idx {
	MOUSE_BTN_REPORT_IDX = 0,
	MOUSE_X_REPORT_IDX = 1,
	MOUSE_Y_REPORT_IDX = 2,
	MOUSE_WHEEL_REPORT_IDX = 3,
	MOUSE_REPORT_COUNT = 4,
} mouse_hid_report_idx_e;


typedef struct mouse_hid {
	struct device const *device;
  struct k_sem ep_write_sem;
  enum usb_dc_status_code status;
} mouse_hid_t;

static mouse_hid_t mouse;


LOG_MODULE_REGISTER(mouse_hid, LOG_LEVEL_INF);

static void rwup_if_suspended() {
	if (IS_ENABLED(CONFIG_USB_DEVICE_REMOTE_WAKEUP)) {
		if (mouse.status == USB_DC_SUSPEND) {
			usb_wakeup_request();
			return;
		}
	}
}

static void _mouse_hid_int_in_ready(const struct device *dev)
{
	ARG_UNUSED(dev);
  LOG_INF("mouse hid is ready ready");
}

static void _mouse_hid_usb_status(enum usb_dc_status_code status, const uint8_t *param) {
  ARG_UNUSED(param);
  mouse.status = status;
}


static uint8_t const mouse_hid_desc[] = HID_MOUSE_REPORT_DESC(2);
static struct hid_ops const mouse_hid_ops = {
  .int_in_ready = _mouse_hid_int_in_ready,
};

int mouse_hid_init(char const *device_name) {
  int ret;

  mouse.device = device_get_binding(device_name);
  if (!mouse.device) {
    LOG_ERR("unable to get USB device");
    return -1;
  }

  usb_hid_register_device(mouse.device, mouse_hid_desc, sizeof(mouse_hid_desc), &mouse_hid_ops);

	usb_hid_init(mouse.device);

	ret = usb_enable(_mouse_hid_usb_status);
	if (ret != 0) {
		LOG_ERR("Failed to enable USB");
		return 0;
	}
  return 0;
}


void mouse_hid_do(const mouse_hid_action_t *action) {
  static int click_state = 0;
	UDC_STATIC_BUF_DEFINE(report, MOUSE_REPORT_COUNT);
  memset(report, 0, sizeof(report));
  mouse_hid_report_idx_e report_idx = 0;
  uint8_t value = 0;

  if (action->action == MOUSE_CLICK_LEFT || action->action == MOUSE_CLICK_RIGHT) {
    click_state ^= 1;
    rwup_if_suspended();
    report_idx = MOUSE_BTN_REPORT_IDX;
    WRITE_BIT(value, action->action == MOUSE_CLICK_LEFT ? MOUSE_BTN_LEFT: MOUSE_BTN_RIGHT, click_state);
  } else {
    report_idx = action->action == MOUSE_MOVE_Y? MOUSE_Y_REPORT_IDX: MOUSE_X_REPORT_IDX;
    value = action->arg;
  }
  report[report_idx] = value;
  hid_int_ep_write(mouse.device, report, MOUSE_REPORT_COUNT, NULL);
}
```

## src/mouse-hid.h
```c
#pragma once

#include <zephyr/kernel.h>
#include <zephyr/device.h>

typedef enum mouse_hid_action_type {
  MOUSE_MOVE_X,
  MOUSE_MOVE_Y,
  MOUSE_CLICK_LEFT,
  MOUSE_CLICK_RIGHT,
} mouse_hid_action_type_e;

typedef struct mouse_hid_action {
  mouse_hid_action_type_e action;
  int arg;
} mouse_hid_action_t;

int mouse_hid_init(char const *device_name);
void mouse_hid_do(mouse_hid_action_t const *action);
```

## src/nec-decoder.c
```c
#include "nec-decoder.h"

#include <stdlib.h>

#include <zephyr/sys/util_macro.h>
#include <zephyr/sys/time_units.h>

#if 1
#define ND_BURST_1_DURATION_US (9000)
#define ND_BURST_2_DURATION_US (4500)
#define ND_LOGICAL_0_DURATION_US (563)
#define ND_LOGICAL_1_DURATION_US (1687)
#define ND_JITTER_US (100)
#define ND_BURST_SIGNAL_FORM_1 NEC_DECODER_SIGNAL_FORM_SPACE
#define ND_BURST_SIGNAL_FORM_2 NEC_DECODER_SIGNAL_FORM_PULSE
#define ND_BIT_START NEC_DECODER_SIGNAL_FORM_SPACE
#define ND_BIT_VAL NEC_DECODER_SIGNAL_FORM_PULSE
#define ND_WAIT_FOR_REPEAT_DURATION_1_US (563)
#define ND_WAIT_FOR_REPEAT_FORM     NEC_DECODER_SIGNAL_FORM_SPACE
#define ND_WAIT_FOR_REPEAT_FORM_NEG NEC_DECODER_SIGNAL_FORM_PULSE
#else
#define ND_BURST_1_DURATION_US (9000)
#define ND_BURST_2_DURATION_US (4500)
#define ND_LOGICAL_0_DURATION_US (563)
#define ND_LOGICAL_1_DURATION_US (1687)
#define ND_JITTER_US (90)
#define ND_BURST_SIGNAL_FORM_1 NEC_DECODER_SIGNAL_FORM_PULSE
#define ND_BURST_SIGNAL_FORM_2 NEC_DECODER_SIGNAL_FORM_SPACE
#define ND_BIT_START NEC_DECODER_SIGNAL_FORM_PULSE
#define ND_BIT_VAL NEC_DECODER_SIGNAL_FORM_SPACE
#endif

#define ND_DUR_EQ(dur, testval) (abs((int) dur - testval) < ND_JITTER_US)

static nec_decoder_result_e _nec_decode_uint16(nec_decoder_t *decoder, uint16_t *field, nec_decoder_signal_t const *signal) {
  if (decoder->bit_no > 15) {
    return NEC_DECODER_FAILED;
  }

  if (signal->form == ND_BIT_START && !decoder->prev_is_start) {
    decoder->prev_is_start = 1;
  } else if (signal->form == ND_BIT_VAL && decoder->prev_is_start) {
    decoder->prev_is_start = 0;
    if (ND_DUR_EQ(signal->duration, ND_LOGICAL_1_DURATION_US)) {
      WRITE_BIT(*field, decoder->bit_no, 1);
    } else if (ND_DUR_EQ(signal->duration, ND_LOGICAL_0_DURATION_US)) {
      WRITE_BIT(*field, decoder->bit_no, 0);
    } else {
      decoder->state = NEC_DECODER_FAILED_TO_DECODE;
      return NEC_DECODER_FAILED;
    }
    ++decoder->bit_no;
  } else {
    decoder->state = NEC_DECODER_FAILED_TO_DECODE;
    return NEC_DECODER_FAILED;
  }

  if (decoder->bit_no == 16) {
    return __NEC_DECODER_UINT16_DECODED;
  }

  return NEC_DECODER_NEEDMORE;
}

static nec_decoder_result_e _nec_decoder_ready_to_decode_run(nec_decoder_t *decoder,
  nec_decoder_message_t *message,
  nec_decoder_signal_t const *signal) {

  if (decoder->bit_no == 0 && signal->form == ND_BURST_SIGNAL_FORM_1 &&
      ND_DUR_EQ(signal->duration, ND_BURST_1_DURATION_US)) {
    decoder->state = NEC_DECODER_BURST_1_PASSED;
  } else {
    decoder->state = NEC_DECODER_FAILED_TO_DECODE;
    return NEC_DECODER_FAILED;
  }
  return NEC_DECODER_NEEDMORE;
}

static nec_decoder_result_e _nec_decoder_burst_1_passed(nec_decoder_t *decoder,
  nec_decoder_message_t *message,
  nec_decoder_signal_t const *signal) {
  if (decoder->bit_no == 0 && 
      signal->form == ND_BURST_SIGNAL_FORM_2 && 
      ND_DUR_EQ(signal->duration, ND_BURST_2_DURATION_US)) {
    decoder->state = NEC_DECODER_BURST_2_PASSED;
    decoder->prev_is_start = 0;
  } else {
    decoder->state = NEC_DECODER_FAILED_TO_DECODE;
    return NEC_DECODER_FAILED;
  }
  return NEC_DECODER_NEEDMORE;
}

static nec_decoder_result_e _nec_decoder_address_decoding(nec_decoder_t *decoder,
  nec_decoder_message_t *message,
  nec_decoder_signal_t const *signal) {
  if (decoder->bit_no > 15) {
    decoder->state = NEC_DECODER_FAILED_TO_DECODE;
    return NEC_DECODER_FAILED;
  }

  nec_decoder_result_e result = _nec_decode_uint16(decoder, &decoder->address, signal);

  if (result == __NEC_DECODER_UINT16_DECODED) {
    if ((((0xff & decoder->address)) ^ (0xff & (decoder->address >> 8))) == 0xff) {
      decoder->state = NEC_DECODER_COMMAND_DECODING;
      decoder->bit_no = 0;
      message->address = (nec_decoder_address_t) (decoder->address & 0xff);
      return NEC_DECODER_NEEDMORE;
    } else {
      decoder->state = NEC_DECODER_FAILED_TO_DECODE;
      return NEC_DECODER_FAILED;
    }
  }

  return result;
}

static nec_decoder_result_e _nec_decoder_command_decoding(nec_decoder_t *decoder,
  nec_decoder_message_t *message,
  nec_decoder_signal_t const *signal) {

  nec_decoder_result_e result = _nec_decode_uint16(decoder, &decoder->command, signal);

  if (result == __NEC_DECODER_UINT16_DECODED) {
    if ((((0xff & decoder->command)) ^ (0xff & (decoder->command >> 8))) == 0xff) {
      decoder->state = NEC_DECODER_WAIT_FOR_REPEAT;
      decoder->bit_no = 0;
      message->command = (nec_decoder_command_t) (decoder->command & 0xff);
      return NEC_DECODER_MESSAGE_DECODED;
    } else {
      decoder->state = NEC_DECODER_FAILED_TO_DECODE;
      return NEC_DECODER_FAILED;
    }
  }

  return NEC_DECODER_NEEDMORE;
}

static nec_decoder_result_e _nec_decoder_wait_for_repeat(nec_decoder_t *decoder,
    nec_decoder_message_t *message,
    nec_decoder_signal_t const *signal) {

  if (signal->form == ND_WAIT_FOR_REPEAT_FORM && ND_DUR_EQ(signal->duration, ND_WAIT_FOR_REPEAT_DURATION_1_US)) {
    decoder->state = NEC_DECODER_REPEAT_1;
  } else {
    decoder->state = NEC_DECODER_FAILED_TO_DECODE;
  }
  return NEC_DECODER_NEEDMORE_TO_REPEAT;
}

static nec_decoder_result_e _nec_decoder_repeat_1(nec_decoder_t *decoder,
    nec_decoder_message_t *message,
    nec_decoder_signal_t const *signal) {
  if (signal->form == ND_WAIT_FOR_REPEAT_FORM_NEG && (signal->duration > 37000 && signal->duration < 110000)) {
    decoder->state = NEC_DECODER_REPEAT_2;
  } else {
    decoder->state = NEC_DECODER_FAILED_TO_DECODE;
  }
  return NEC_DECODER_NEEDMORE_TO_REPEAT;
}

static nec_decoder_result_e _nec_decoder_repeat_2(nec_decoder_t *decoder,
    nec_decoder_message_t *message,
    nec_decoder_signal_t const *signal) {
  if (signal->form == ND_WAIT_FOR_REPEAT_FORM && ND_DUR_EQ(signal->duration, 9000)) {
    decoder->state = NEC_DECODER_REPEAT_3;
  } else {
    decoder->state = NEC_DECODER_FAILED_TO_DECODE;
  }
  return NEC_DECODER_NEEDMORE_TO_REPEAT;
}

static nec_decoder_result_e _nec_decoder_repeat_3(nec_decoder_t *decoder,
    nec_decoder_message_t *message,
    nec_decoder_signal_t const *signal) {
  if (signal->form == ND_WAIT_FOR_REPEAT_FORM_NEG && ND_DUR_EQ(signal->duration, 2300)) {
    decoder->state = NEC_DECODER_REPEAT_4;
  } else if (signal->form == ND_BURST_SIGNAL_FORM_2 && ND_DUR_EQ(signal->duration, ND_BURST_2_DURATION_US)) {
    // TODO Write a test for this case
    decoder->state = NEC_DECODER_BURST_2_PASSED;
    decoder->prev_is_start = 0;
    return NEC_DECODER_NEEDMORE;
  } else {
    decoder->state = NEC_DECODER_FAILED_TO_DECODE;
  }
  return NEC_DECODER_NEEDMORE_TO_REPEAT;
}

static nec_decoder_result_e _nec_decoder_repeat_4(nec_decoder_t *decoder,
    nec_decoder_message_t *message,
    nec_decoder_signal_t const *signal) {
  if (signal->form == ND_WAIT_FOR_REPEAT_FORM && ND_DUR_EQ(signal->duration, 540)) {
    decoder->state = NEC_DECODER_REPEAT_1;
  } else {
    decoder->state = NEC_DECODER_FAILED_TO_DECODE;
  }
  return NEC_DECODER_REPEAT_DECODED;
}
 

void nec_decoder_init(nec_decoder_t *decoder) {
  decoder->state = NEC_DECODER_READY_TO_DECODE;
  decoder->bit_no = 0;
  decoder->address = 0;
  decoder->command = 0;
  decoder->prev_is_start = 0;
}


nec_decoder_result_e nec_decoder_feed(nec_decoder_t *decoder,
    nec_decoder_message_t *message,
    nec_decoder_signal_t const *signal) {
  switch (decoder->state) {
  case NEC_DECODER_READY_TO_DECODE:
    return _nec_decoder_ready_to_decode_run(decoder, message, signal);
    break;
  case NEC_DECODER_BURST_1_PASSED:
    return _nec_decoder_burst_1_passed(decoder, message, signal);
    break;
  case NEC_DECODER_BURST_2_PASSED:
    return _nec_decoder_address_decoding(decoder, message, signal);
    break;
  case NEC_DECODER_COMMAND_DECODING:
    return _nec_decoder_command_decoding(decoder, message, signal);
    break;
  case NEC_DECODER_WAIT_FOR_REPEAT:
    return _nec_decoder_wait_for_repeat(decoder, message, signal);
    break;
  case NEC_DECODER_REPEAT_1:
    return _nec_decoder_repeat_1(decoder, message, signal);
    break;
  case NEC_DECODER_REPEAT_2:
    return _nec_decoder_repeat_2(decoder, message, signal);
    break;
  case NEC_DECODER_REPEAT_3: {
    return _nec_decoder_repeat_3(decoder, message, signal);
    break;
    }
  case NEC_DECODER_REPEAT_4:
    return _nec_decoder_repeat_4(decoder, message, signal);
    break;
  case NEC_DECODER_FAILED_TO_DECODE:
    return NEC_DECODER_FAILED;
    break;
  }
  return NEC_DECODER_FAILED;
}

void nec_signal_converter_init(nec_signal_converter_t *converter) {
  converter->tick0 = 0;
  converter->tick1 = 0;
  converter->level = 0;
}


nec_signal_result_e nec_convert_to_signal(nec_signal_converter_t *converter, int level, int64_t tick) {
  if (level == converter->level) {
    return NEC_SIGNAL_CONVERTER_FAILED;
  }
  converter->tick0 = converter->tick1;
  converter->tick1 = tick;

  converter->signal.duration = 	k_cyc_to_ns_ceil32(converter->tick1 - converter->tick0);
  converter->signal.form = converter->level? NEC_DECODER_SIGNAL_FORM_PULSE: NEC_DECODER_SIGNAL_FORM_SPACE;
  converter->level = level;
  return NEC_SIGNAL_CONVERTER_SUCCESS;
}
```

## src/nec-decoder.h
```c
#pragma once

#include <stdint.h>

typedef uint8_t nec_decoder_command_t;
typedef uint8_t nec_decoder_address_t;
typedef uint16_t nec_decoder_decoding_address_t;
typedef uint16_t nec_decoder_decoding_command_t;
typedef uint32_t nec_decoder_duration_usec_t;

typedef enum nec_decoder_state {
  NEC_DECODER_READY_TO_DECODE,
  NEC_DECODER_FAILED_TO_DECODE,
  NEC_DECODER_BURST_1_PASSED,
  NEC_DECODER_BURST_2_PASSED,
  NEC_DECODER_COMMAND_DECODING,
  NEC_DECODER_WAIT_FOR_REPEAT,
  NEC_DECODER_REPEAT_1,
  NEC_DECODER_REPEAT_2,
  NEC_DECODER_REPEAT_3,
  NEC_DECODER_REPEAT_4,
} nec_decoder_state_e;

typedef enum nec_decoder_result {
  NEC_DECODER_MESSAGE_DECODED,
  NEC_DECODER_NEEDMORE,
  NEC_DECODER_FAILED,
  NEC_DECODER_NEEDMORE_TO_REPEAT,
  NEC_DECODER_REPEAT_DECODED,

  // Internal states
  __NEC_DECODER_UINT16_DECODED,
} nec_decoder_result_e;

typedef enum nec_decoder_signal_form {
  NEC_DECODER_SIGNAL_FORM_PULSE,
  NEC_DECODER_SIGNAL_FORM_SPACE,
} nec_decoder_signal_form_e;

typedef enum nec_signal_result {
  NEC_SIGNAL_CONVERTER_SUCCESS,
  NEC_SIGNAL_CONVERTER_FAILED,
} nec_signal_result_e;

typedef struct nec_decoder_signal {
  nec_decoder_signal_form_e form;
  nec_decoder_duration_usec_t duration;
} nec_decoder_signal_t;

typedef struct nec_decoder {
  nec_decoder_state_e state;
  int8_t bit_no;
  int8_t prev_is_start;
  nec_decoder_decoding_address_t address;
  nec_decoder_decoding_command_t command;
} nec_decoder_t;


typedef struct nec_decoder_message { 
  nec_decoder_address_t address;
  nec_decoder_command_t command;
} nec_decoder_message_t;

typedef struct nec_signal_converter {
  nec_decoder_signal_t signal;
  int64_t tick0;
  int64_t tick1;
  int level;
} nec_signal_converter_t;

void nec_decoder_init(nec_decoder_t *decoder);
nec_decoder_result_e nec_decoder_feed(nec_decoder_t *decoder, nec_decoder_message_t *message, nec_decoder_signal_t const *signal);

void nec_signal_converter_init(nec_signal_converter_t *converter);
nec_signal_result_e nec_convert_to_signal(nec_signal_converter_t *converter, int level, int64_t tick);
```

## src/rc-command.h
```c
#pragma once

#define RC_COMMAND_RIGHT      (90)
#define RC_COMMAND_LEFT       (8)
#define RC_COMMAND_UP         (24)
#define RC_COMMAND_DOWN       (82)
#define RC_COMMAND_LEFT_CLICK (28)
```

## src/rc-mouse.c
```c
#include "rc-mouse.h"
#include "mouse-hid.h"

#include <zephyr/logging/log.h>
#include <zephyr/kernel.h>

#define RC_MOUSE_SPEED (7)

LOG_MODULE_REGISTER(rc_mouse);

static int _hid_from_rc_state(mouse_hid_action_t *action, rc_mouse_state_t const *state) {
  if (state->current_action == RC_MOUSE_REPEAT) {
    return -1;
  }
  switch (state->current_action) {
  case RC_MOUSE_MOVE_UP:
    action->action = MOUSE_MOVE_Y;
    action->arg = -state->speed;
    break;
  case RC_MOUSE_MOVE_DOWN:
    action->action = MOUSE_MOVE_Y;
    action->arg = state->speed;
    break;
  case RC_MOUSE_MOVE_LEFT:
    action->action = MOUSE_MOVE_X;
    action->arg = -state->speed;
    break;
  case RC_MOUSE_MOVE_RIGHT:
    action->action = MOUSE_MOVE_X;
    action->arg = state->speed;
    break;
  default:
    LOG_WRN("unknown action");
    break;
  }
  return 0;
}

int rc_state_from_hid(rc_mouse_state_t *state, mouse_hid_action_t const *action) {

}

void rc_mouse_thread(void *rc_mouse_raw, void *arg1, void *arg2) {
  UNUSED(arg1);
  UNUSED(arg2);
  rc_mouse_input_t input = {0};
  mouse_hid_action_t action = {0};
  rc_mouse_state_t *rc_mouse = rc_mouse_raw;
  while (1) {
    k_msgq_get(rc_mouse->msgq, &input, K_FOREVER);
    if (input.type == RC_MOUSE_REPEAT) {
      if (rc_mouse->speed < 50) {
        rc_mouse->speed += RC_MOUSE_SPEED;
      }
      if (_hid_from_rc_state(&action, rc_mouse) != 0) {
        LOG_WRN("got incorrent mouse state");
        return;
      }
    } else {
      rc_mouse->speed = 1;
      rc_mouse->current_action = input.type;
      switch (input.type) {
      case RC_MOUSE_MOVE_UP:
        action.action = MOUSE_MOVE_Y;
        break;
      case RC_MOUSE_MOVE_DOWN:
        action.action = MOUSE_MOVE_Y;
        break;
      case RC_MOUSE_MOVE_LEFT:
        action.action = MOUSE_MOVE_X;
        break;
      case RC_MOUSE_MOVE_RIGHT:
        action.action = MOUSE_MOVE_X;
        break;
      case RC_MOUSE_CLICK_LEFT:
        action.action = MOUSE_CLICK_LEFT;
        break;
      case RC_MOUSE_CLICK_RIGHT:
        action.action = MOUSE_CLICK_RIGHT;
        break;
      default:
        // repeat unreachable
        LOG_WRN("incorrenct action");
        return;
        break;
      }
    }
    mouse_hid_do(&action);
  }
}

void rc_mouse_state_init(rc_mouse_state_t *this, struct k_msgq *msgq) {
  this->current_action = 0;
  this->speed = 1;
  this->msgq = msgq;
}

static struct k_thread rc_mouse_thread_data;
K_THREAD_STACK_DEFINE(rc_mouse_thread_stack, 500);
static rc_mouse_state_t rc_mouse_state;

k_tid_t rc_mouse_start_thread(struct k_msgq *queue) {
  rc_mouse_state_init(&rc_mouse_state, queue);
  k_tid_t tid = k_thread_create(&rc_mouse_thread_data,
      rc_mouse_thread_stack,
      K_THREAD_STACK_SIZEOF(rc_mouse_thread_stack),
      rc_mouse_thread,
      &rc_mouse_state, NULL, NULL,
      1, 0, K_NO_WAIT);
  return tid;
}
```

## src/rc-mouse.h
```c
#pragma once

#include "mouse-hid.h"

#include <zephyr/kernel.h>

typedef enum rc_mouse_input_type {
  RC_MOUSE_MOVE_UP,
  RC_MOUSE_MOVE_DOWN,
  RC_MOUSE_MOVE_LEFT,
  RC_MOUSE_MOVE_RIGHT,
  RC_MOUSE_CLICK_LEFT,
  RC_MOUSE_CLICK_RIGHT,
  RC_MOUSE_REPEAT,
} rc_mouse_input_type_e;

typedef struct rc_mouse_input {
  rc_mouse_input_type_e type;
  uint32_t arg;
} rc_mouse_input_t;

typedef struct rc_mouse_state {
  rc_mouse_input_type_e current_action;
  int speed;
  struct k_msgq *msgq;
} rc_mouse_state_t;

void rc_mouse_state_init(rc_mouse_state_t *this, struct k_msgq *msgq);
k_tid_t rc_mouse_start_thread(struct k_msgq *queue);
```
